## arch/mips/configs/loongson3_defconfig
```kconfig
CONFIG_MACH_LOONGSON=y
CONFIG_LEMOTE_MACH3A=y
CONFIG_LOONGSON_BIGMEM=y
CONFIG_CPU_LOONGSON3=y
CONFIG_64BIT=y
CONFIG_PAGE_SIZE_16KB=y
CONFIG_SPARSEMEM_MANUAL=y
CONFIG_KSM=y
CONFIG_SMP=y
CONFIG_NR_CPUS=4
CONFIG_HZ_256=y
CONFIG_PREEMPT=y
CONFIG_KEXEC=y
CONFIG_EXPERIMENTAL=y
# CONFIG_LOCALVERSION_AUTO is not set
CONFIG_SYSVIPC=y
CONFIG_POSIX_MQUEUE=y
CONFIG_BSD_PROCESS_ACCT=y
CONFIG_BSD_PROCESS_ACCT_V3=y
CONFIG_AUDIT=y
CONFIG_NO_HZ=y
CONFIG_HIGH_RES_TIMERS=y
CONFIG_LOG_BUF_SHIFT=14
CONFIG_CPUSETS=y
CONFIG_RESOURCE_COUNTERS=y
CONFIG_CGROUP_MEM_RES_CTLR=y
CONFIG_CGROUP_MEM_RES_CTLR_SWAP=y
CONFIG_BLK_CGROUP=y
CONFIG_SCHED_AUTOGROUP=y
CONFIG_SYSFS_DEPRECATED=y
CONFIG_RELAY=y
CONFIG_BLK_DEV_INITRD=y
CONFIG_CC_OPTIMIZE_FOR_SIZE=y
CONFIG_SYSCTL_SYSCALL=y
CONFIG_EMBEDDED=y
CONFIG_MODULES=y
CONFIG_MODULE_UNLOAD=y
CONFIG_MODULE_FORCE_UNLOAD=y
CONFIG_PARTITION_ADVANCED=y
CONFIG_CFQ_GROUP_IOSCHED=y
CONFIG_PCI=y
CONFIG_HT_PCI=y
CONFIG_HOTPLUG_PCI=y
CONFIG_HOTPLUG_PCI_SHPC=m
CONFIG_MIPS32_COMPAT=y
CONFIG_MIPS32_O32=y
CONFIG_MIPS32_N32=y
CONFIG_PM_RUNTIME=y
CONFIG_PACKET=y
CONFIG_UNIX=y
CONFIG_INET=y
CONFIG_IP_MULTICAST=y
CONFIG_IP_ADVANCED_ROUTER=y
CONFIG_IP_MULTIPLE_TABLES=y
CONFIG_IP_ROUTE_MULTIPATH=y
CONFIG_IP_ROUTE_VERBOSE=y
CONFIG_NETFILTER=y
CONFIG_NETFILTER_NETLINK_LOG=m
CONFIG_NETFILTER_XT_TARGET_CLASSIFY=m
CONFIG_NETFILTER_XT_TARGET_MARK=m
CONFIG_NETFILTER_XT_TARGET_NFQUEUE=m
CONFIG_NETFILTER_XT_MATCH_COMMENT=m
CONFIG_NETFILTER_XT_MATCH_DCCP=m
CONFIG_NETFILTER_XT_MATCH_ESP=m
CONFIG_NETFILTER_XT_MATCH_LENGTH=m
CONFIG_NETFILTER_XT_MATCH_LIMIT=m
CONFIG_NETFILTER_XT_MATCH_MAC=m
CONFIG_NETFILTER_XT_MATCH_MARK=m
CONFIG_NETFILTER_XT_MATCH_MULTIPORT=m
CONFIG_NETFILTER_XT_MATCH_PKTTYPE=m
CONFIG_NETFILTER_XT_MATCH_QUOTA=m
CONFIG_NETFILTER_XT_MATCH_REALM=m
CONFIG_NETFILTER_XT_MATCH_SCTP=m
CONFIG_NETFILTER_XT_MATCH_STATISTIC=m
CONFIG_NETFILTER_XT_MATCH_STRING=m
CONFIG_NETFILTER_XT_MATCH_TCPMSS=m
CONFIG_IP_NF_QUEUE=m
CONFIG_IP_NF_IPTABLES=m
CONFIG_IP_NF_MATCH_AH=m
CONFIG_IP_NF_MATCH_ECN=m
CONFIG_IP_NF_MATCH_TTL=m
CONFIG_IP_NF_FILTER=m
CONFIG_IP_NF_TARGET_REJECT=m
CONFIG_IP_NF_TARGET_ULOG=m
CONFIG_IP_NF_MANGLE=m
CONFIG_IP_NF_TARGET_ECN=m
CONFIG_IP_NF_TARGET_TTL=m
CONFIG_IP_NF_RAW=m
CONFIG_IP_NF_ARPTABLES=m
CONFIG_IP_NF_ARPFILTER=m
CONFIG_IP_NF_ARP_MANGLE=m
CONFIG_CFG80211=y
CONFIG_LIB80211=y
CONFIG_MAC80211=y
CONFIG_RFKILL=y
CONFIG_RFKILL_INPUT=y
CONFIG_UEVENT_HELPER_PATH="/sbin/hotplug"
CONFIG_DEVTMPFS=y
CONFIG_DEVTMPFS_MOUNT=y
CONFIG_MTD=y
CONFIG_BLK_DEV_LOOP=y
CONFIG_BLK_DEV_CRYPTOLOOP=y
CONFIG_BLK_DEV_RAM=y
CONFIG_BLK_DEV_RAM_SIZE=8192
CONFIG_RAID_ATTRS=m
CONFIG_SCSI_TGT=y
CONFIG_BLK_DEV_SD=y
CONFIG_CHR_DEV_SG=y
CONFIG_CHR_DEV_SCH=m
CONFIG_SCSI_MULTI_LUN=y
CONFIG_SCSI_CONSTANTS=y
CONFIG_SCSI_LOGGING=y
CONFIG_SCSI_SPI_ATTRS=m
CONFIG_SCSI_FC_ATTRS=m
CONFIG_SCSI_ISCSI_ATTRS=m
CONFIG_ATA=y
CONFIG_SATA_AHCI=y
CONFIG_MD=y
CONFIG_BLK_DEV_DM=y
CONFIG_DM_CRYPT=y
CONFIG_DM_SNAPSHOT=y
CONFIG_DM_MIRROR=y
CONFIG_DM_ZERO=y
CONFIG_NETDEVICES=y
CONFIG_R8169=y
CONFIG_ATH_COMMON=y
CONFIG_ATH9K=y
CONFIG_INPUT_POLLDEV=m
CONFIG_INPUT_SPARSEKMAP=y
CONFIG_INPUT_EVDEV=y
CONFIG_KEYBOARD_XTKBD=m
CONFIG_MOUSE_PS2_SENTELIC=y
CONFIG_MOUSE_SERIAL=m
CONFIG_INPUT_MISC=y
CONFIG_INPUT_UINPUT=m
CONFIG_SERIO_SERPORT=m
CONFIG_SERIO_RAW=m
CONFIG_LEGACY_PTY_COUNT=16
CONFIG_SERIAL_NONSTANDARD=y
CONFIG_N_HDLC=m
CONFIG_STALDRV=y
CONFIG_SERIAL_8250=y
CONFIG_SERIAL_8250_CONSOLE=y
CONFIG_SERIAL_8250_NR_UARTS=16
CONFIG_SERIAL_8250_EXTENDED=y
CONFIG_SERIAL_8250_MANY_PORTS=y
CONFIG_SERIAL_8250_SHARE_IRQ=y
CONFIG_SERIAL_8250_RSA=y
CONFIG_IPMI_HANDLER=m
CONFIG_IPMI_DEVICE_INTERFACE=m
CONFIG_IPMI_SI=m
CONFIG_IPMI_WATCHDOG=m
CONFIG_IPMI_POWEROFF=m
CONFIG_HW_RANDOM=y
CONFIG_R3964=m
CONFIG_RAW_DRIVER=m
CONFIG_I2C_CHARDEV=y
CONFIG_I2C_PIIX4=y
CONFIG_SPI=y
CONFIG_SPI_BITBANG=m
CONFIG_SENSORS_ADM1021=m
CONFIG_SENSORS_ADM1025=m
CONFIG_SENSORS_ADM1026=m
CONFIG_SENSORS_ADM1031=m
CONFIG_SENSORS_ADM9240=m
CONFIG_SENSORS_ATXP1=m
CONFIG_SENSORS_DS1621=m
CONFIG_SENSORS_GL518SM=m
CONFIG_SENSORS_GL520SM=m
CONFIG_SENSORS_IT87=m
CONFIG_SENSORS_LM63=m
CONFIG_SENSORS_LM70=m
CONFIG_SENSORS_LM75=m
CONFIG_SENSORS_LM77=m
CONFIG_SENSORS_LM78=m
CONFIG_SENSORS_LM80=m
CONFIG_SENSORS_LM83=m
CONFIG_SENSORS_LM85=m
CONFIG_SENSORS_LM87=m
CONFIG_SENSORS_LM90=m
CONFIG_SENSORS_LM92=m
CONFIG_SENSORS_MAX1619=m
CONFIG_SENSORS_PC87360=m
CONFIG_SENSORS_SMSC47M1=m
CONFIG_SENSORS_SMSC47M192=m
CONFIG_SENSORS_SMSC47B397=m
CONFIG_SENSORS_W83781D=m
CONFIG_SENSORS_W83791D=m
CONFIG_SENSORS_W83792D=m
CONFIG_SENSORS_W83793=m
CONFIG_SENSORS_W83L785TS=m
CONFIG_SENSORS_W83627HF=m
CONFIG_SENSORS_W83627EHF=m
CONFIG_DRM=y
CONFIG_DRM_RADEON=y
CONFIG_DRM_RADEON_KMS=y
CONFIG_VIDEO_OUTPUT_CONTROL=y
CONFIG_FB_RADEON=y
CONFIG_FB_ATY128=y
CONFIG_FB_ATY=y
CONFIG_FB_ATY_CT=y
CONFIG_FB_ATY_GENERIC_LCD=y
CONFIG_FB_ATY_GX=y
CONFIG_LCD_CLASS_DEVICE=y
# CONFIG_VGA_CONSOLE is not set
CONFIG_FRAMEBUFFER_CONSOLE=y
CONFIG_FRAMEBUFFER_CONSOLE_ROTATION=y
CONFIG_LOGO=y
CONFIG_SOUND=y
CONFIG_SND=y
CONFIG_SND_SEQUENCER=m
CONFIG_SND_SEQ_DUMMY=m
CONFIG_SND_DUMMY=y
CONFIG_SND_ALOOP=y
CONFIG_SND_HDA_INTEL=y
CONFIG_SND_HDA_PATCH_LOADER=y
CONFIG_HID_A4TECH=m
CONFIG_USB=y
CONFIG_USB_MON=y
CONFIG_USB_EHCI_HCD=y
CONFIG_USB_EHCI_ROOT_HUB_TT=y
CONFIG_USB_OHCI_HCD=y
CONFIG_USB_UHCI_HCD=m
CONFIG_USB_STORAGE=m
CONFIG_RTC_CLASS=y
CONFIG_RTC_DRV_CMOS=y
CONFIG_DMADEVICES=y
CONFIG_EXT2_FS=y
CONFIG_EXT2_FS_XATTR=y
CONFIG_EXT2_FS_POSIX_ACL=y
CONFIG_EXT2_FS_SECURITY=y
CONFIG_EXT3_FS=y
CONFIG_EXT3_FS_POSIX_ACL=y
CONFIG_EXT3_FS_SECURITY=y
CONFIG_EXT4_FS=y
CONFIG_EXT4_FS_POSIX_ACL=y
CONFIG_EXT4_FS_SECURITY=y
CONFIG_QUOTA=y
CONFIG_AUTOFS4_FS=y
CONFIG_FUSE_FS=m
CONFIG_ISO9660_FS=m
CONFIG_JOLIET=y
CONFIG_PROC_KCORE=y
CONFIG_TMPFS=y
CONFIG_NFS_FS=m
CONFIG_NFS_V3_ACL=y
CONFIG_NFS_V4=y
CONFIG_NFSD=m
CONFIG_NFSD_V3_ACL=y
CONFIG_NFSD_V4=y
CONFIG_CIFS=m
CONFIG_NLS_CODEPAGE_437=y
CONFIG_NLS_CODEPAGE_936=y
CONFIG_NLS_UTF8=y
CONFIG_PRINTK_TIME=y
CONFIG_FRAME_WARN=1024
CONFIG_MAGIC_SYSRQ=y
CONFIG_STRIP_ASM_SYMS=y
CONFIG_DEBUG_SECTION_MISMATCH=y
CONFIG_CRYPTO_AUTHENC=m
CONFIG_CRYPTO_HMAC=y
CONFIG_CRYPTO_MD5=y
CONFIG_CRYPTO_MICHAEL_MIC=m
CONFIG_CRYPTO_SHA1=m
CONFIG_CRYPTO_SHA256=m
CONFIG_CRYPTO_SHA512=m
CONFIG_CRYPTO_TGR192=m
CONFIG_CRYPTO_WP512=m
CONFIG_CRYPTO_ANUBIS=m
CONFIG_CRYPTO_BLOWFISH=m
CONFIG_CRYPTO_CAST5=m
CONFIG_CRYPTO_CAST6=m
CONFIG_CRYPTO_KHAZAD=m
CONFIG_CRYPTO_SERPENT=m
CONFIG_CRYPTO_TEA=m
CONFIG_CRYPTO_TWOFISH=m
CONFIG_CRYPTO_DEFLATE=m
CONFIG_CRC_T10DIF=m
CONFIG_LIBCRC32C=m
```

## drivers/gpu/drm/loongson/Kconfig
```kconfig
config DRM_LOONGSON
	tristate "DRM support for LS2H/LS7A Display Controller"
	depends on DRM && PCI
	select FB_CFB_FILLRECT
	select FB_CFB_COPYAREA
	select FB_CFB_IMAGEBLIT
	select DRM_KMS_HELPER
	select DRM_KMS_FB_HELPER
	select DRM_TTM
	default n
	help
	  Support the display controllers found on the Loongson LS2H/LS7A
	  bridge.

	  This driver provides no built-in acceleration; acceleration is
	  performed by Vivante GC1000. This driver provides kernel mode
	  setting and buffer management to userspace.
```

## drivers/gpu/drm/smi/Kconfig
```kconfig
config DRM_SMI
	tristate "SMI DRM driver"
	depends on DRM && PCI
	select DRM_TTM
	select DRM_KMS_HELPER
	help
	 Say yes for SMI GPU driver (SM750 & SM768).

config DRM_SMI_HDMI
	bool "enable SMI HDMI"
	depends on DRM_SMI
	help
	  Compile in support for HDMI.

config DRM_SMI_AUDIO
	bool "enable SMI Audio"
	depends on DRM_SMI
	help
	  Compile in support for Audio.

config DRM_SMI_PRIME
	bool "enable SMI PRIME"
	depends on DRM_SMI
	help
	  Compile in support for PRIME.
```

## drivers/platform/Kconfig
```kconfig
if X86
source "drivers/platform/x86/Kconfig"
endif
if GOLDFISH
source "drivers/platform/goldfish/Kconfig"
endif
if MIPS
source "drivers/platform/mips/Kconfig"
endif
```

## drivers/platform/mips/Kconfig
```kconfig
#
# MIPS Platform Specific Drivers
#

menuconfig MIPS_PLATFORM_DEVICES
	bool "MIPS Platform Specific Device Drivers"
	default y
	help
	  Say Y here to get to see options for device drivers of various
	  MIPS platforms, including vendor-specific netbook/laptop/pc extension
	  drivers.  This option alone does not add any kernel code.

	  If you say N, all options in this submenu will be skipped and disabled.

if MIPS_PLATFORM_DEVICES

config LEMOTE3A_LAPTOP
	tristate "Lemote Loongson-3A Laptop Driver"
	depends on LEMOTE_MACH3A
	select BACKLIGHT_LCD_SUPPORT
	select LCD_CLASS_DEVICE
	select BACKLIGHT_CLASS_DEVICE
	select POWER_SUPPLY
	select HWMON
	select VIDEO_OUTPUT_CONTROL
	select INPUT_SPARSEKMAP
	select INPUT_EVDEV
	depends on INPUT
	default y
	help
	  Lemote Loongson-3A/2Gq family laptops driver.

endif # MIPS_PLATFORM_DEVICES
```

## drivers/video/fbdev/vivante/Kconfig
```kconfig
menuconfig VIVANTE
	tristate "Loongson-2H VIVANTE GPU Driver Support"
	depends on FB_LS2H
	default y
	help
	  This option enable Loongson-2H Vivante GPU kernel driver support.

if VIVANTE

config USE_POWER_MANAGEMENT 
	int "USE_POWER_MANAGEMENT"
	depends on VIVANTE
	default 0

config AL_VDMEMY_CACHED
	int "FORCE_ALL_VIDEO_MEMORY_CACHED"
	depends on VIVANTE
	default 0

config NPGD_MEM_CACHEABLE 
	int "NONPAGED_MEMORY_CACHEABLE"
	depends on VIVANTE
	default 0

config NPGD_MEM_BUFFABLE 
	int "NONPAGED_MEMORY_BUFFERABLE"
	depends on VIVANTE
	default 0

config CACHE_FUNC_UNIMPLMT 
	int "CACHE_FUNCTION_UNIMPLEMENTED"
	depends on VIVANTE
	default 0

config VIVANTE_ENABLE_VG 
	int "VIVANTE_ENABLE_VG"
	depends on VIVANTE
	default 1
	help
	   VIV_ENABLE_VG          1      Built in GC350 HAL support; default value;
	                          0      Do not build in GC350 HAL support;

config NO_D_A_F_K 
	int "NO_DIRECT_ACCESS_FROM_KERNEL"
	depends on VIVANTE
	default 1

config VIVANTE_NO_3D 
	int "VIVANTE_NO_3D"
	depends on VIVANTE
	default 0

config ENABLE_OUTER_CACHE_PATCH 
	int "ENABLE_OUTER_CACHE_PATCH"
	depends on VIVANTE
	default 1

config USE_BANK_ALIGNMENT 
	int "USE_BANK_ALIGNMENT"
	depends on VIVANTE
	default 0

config BANK_BIT_START 
	int "BANK_BIT_START"
	depends on VIVANTE
	default 0

config BANK_BIT_END 
	int "BANK_BIT_END"
	depends on VIVANTE
	default 0

config BANK_CHANNEL_BIT 
	int "BANK_CHANNEL_BIT"
	depends on VIVANTE
	default 0

#------------------------------------------------------------------

config VIV_DEBUG
	int "Debug option"
	depends on VIVANTE
	default 0
	help
	   1 Enable debugging.  0 Disable debugging.

config VIV_NO_DMA_COHERENT
	int "DMA function coherent" 
	depends on VIVANTE
	default 0
	help
	NO_DMA_COHERENT            1      Disable coherent DMA function.
	                           0      Enable coherent DMA function.

config GPU_CLOCK 
	int "Set GPU clock in driver"
	depends on VIVANTE
	default 0
	help
	   ENABLE_GPU_CLOCK_BY_DRIVER 1      Set the GPU clock in the driver.    
	                              0      The GPU clock should be set by BSP.

config USE_PLATFORM_DRIVER 
	int "Platform deiver model"
	depends on VIVANTE
	default 1
	help
	   USE_PLATFORM_DRIVER        1      Use platform driver model to build kernel     
	                                     module on linux while kernel version is 2.6.0
				      0	     Use legecy kernel driver model.

config VIV_USE_PROFILER 
	int "Profile function"
	depends on VIVANTE
	default 0
	help
	   USE_PROFILER               0      Disable driver profiler function; 
	                              1      Enable driver profiler function;

config VIV_DIRECTFB_MAJOR_VERSION 
	int "DFB driver Major Version" 
	depends on VIVANTE
	default 1

config VIV_DIRECTFB_MINOR_VERSION 
	int "DFB driver Minor Version" 
	depends on VIVANTE
	default 4

config VIV_DIRECTFB_MICRO_VERSION 
	int "DFB driver Micro Version" 
	depends on VIVANTE
	default 0
endif
```

## sound/mips/hda/Kconfig
```kconfig
menuconfig SND_HDA_LS2H
	tristate "Loongson-2H HD Audio"
	depends on CPU_LOONGSON3
	select SND_PCM
	select SND_VMASTER
	select SND_KCTL_JACK
	help
	  Say Y here to include support for Loongson-2H "High Definition
	  Audio".

if SND_HDA_LS2H

config LS2H_HDA_PREALLOC_SIZE
	int "Pre-allocated buffer size for HD-audio driver"
	range 0 32768
	default 64
	help
	  Specifies the default pre-allocated buffer-size in kB for the
	  HD-audio driver.  A larger buffer (e.g. 2048) is preferred
	  for systems using PulseAudio.  The default 64 is chosen just
	  for compatibility reasons.

	  Note that the pre-allocation size can be changed dynamically
	  via a proc file (/proc/asound/card*/pcm*/sub*/prealloc), too.

config LS2H_HDA_INPUT_JACK
	bool "Support jack plugging notification via input layer"
	depends on INPUT=y || INPUT=SND
	select SND_JACK
	help
	  Say Y here to enable the jack plugging notification via
	  input layer.

config LS2H_HDA_POWER_SAVE_DEFAULT
	int "Default time-out for HD-audio power-save mode"
	depends on PM
	default 0
	help
	  The default time-out value in seconds for HD-audio automatic
	  power-save mode.  0 means to disable the power-save mode.

endif
```
